## kernel-3.10/drivers/misc/mediatek/spm/Kconfig
```kconfig
config MTK_SPM
	bool "Enable MTK SPM suspend function"
	depends on SUSPEND
	default y if SUSPEND
	help
	  Enable MTK SPM suspend function.
```

## kernel-3.10/drivers/misc/mediatek/sw_tx_power/Kconfig
```kconfig
config MTK_SWITCH_TX_POWER
    bool "ENABLE TX POWER SWITCH"
    default n
    ---help---
      MediaTek SWTP driver
```

## kernel-3.10/drivers/misc/mediatek/sync/Kconfig
```kconfig
config MTK_SYNC
	bool "Simplified software synchronization objects"
	default n
	depends on SW_SYNC
	help
	  A simplified SW_SYNC that provides essential APIs for
	  other kernel modules.
```

## kernel-3.10/drivers/misc/mediatek/systracker/Kconfig
```kconfig
config MTK_SYSTRACKER
        bool "Enable MTK System Tracker Debugger"
        help
          SYSTRACKER is a hardware debugger to record timeout transaction and trigger SLV_ERR or interrupt to notify CPU.

config MTK_SYSTRACKER_V2
        bool "Enable MTK System Tracker Debugger V2"
        help
          SYSTRACKER is a hardware debugger to record timeout transaction and trigger SLV_ERR or interrupt to notify CPU.
	  Support 2 stage timeout & watchpoint SLV_ERR
```

## kernel-3.10/drivers/misc/mediatek/trustzone/Kconfig
```kconfig
config HAVE_MTK_IN_HOUSE_TEE_SUPPORT
	bool "Enable MTK in-house TEE Solution"
	def_bool n

config MTK_IN_HOUSE_TEE_SUPPORT
	bool "Enable MTK In House TEE Support"
	depends on HAVE_MTK_IN_HOUSE_TEE_SUPPORT
	default n
	help
	  This enable MTK TEE support.
```

## kernel-3.10/drivers/misc/mediatek/vdec/Kconfig
```kconfig
# LDVT_VDEC
config MTK_LDVT_VDEC
	bool "MediaTek LDVT VDEC Driver"
	depends on MTK_LDVT
	default n
	help
	  LDVT VDEC is used to vefiry VDEC HW in FPGA/DVT stage.
	  Video format : H.264, H.265, MPEG4, RM, VP6, VP8,
	  WMV, AVS, ...
```

## kernel-3.10/drivers/pinctrl/mediatek/Kconfig
```kconfig
if ARCH_MEDIATEK

config PINCTRL_MTK_COMMON
	bool
	select PINMUX
	select GENERIC_PINCONF
	select GPIOLIB
	select OF_GPIO

config PINCTRL_MT8135
	def_bool MACH_MT8135
	select PINCTRL_MTK_COMMON

config PINCTRL_MT8173
	def_bool MACH_MT8173
	select PINCTRL_MTK_COMMON

endif

config PINCTRL_MTK_COMMON
	bool "pinctrl mtk common"
	default n
	select PINMUX
	select GENERIC_PINCONF
	select GPIOLIB
	select OF_GPIO

config PINCTRL_MT6735
	bool "pinctrl mt6735"
	default n
	def_bool MACH_MT6735
	select PINCTRL_MTK_COMMON

config PINCTRL_MT6580
	bool "pinctrl mt6580"
	default n
	def_bool MACH_MT6580
	select PINCTRL_MTK_COMMON
```

## kernel-3.10/fs/rawfs/Kconfig
```kconfig
config RAWFS_FS
        tristate "RAW File System for NAND Flash (Experimental)"
        help
        NAND based file system, used to store SML files for MTK modems.
```
