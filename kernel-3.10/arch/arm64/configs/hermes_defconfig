## kernel-3.10/drivers/misc/mediatek/Kconfig.kernel
```kconfig
# TODO naming refine
menu "Kernel Configurations"

menu "Tracer Related"
config MTK_SCHED_TRACERS
	bool "MTK Sched Tracers"
	depends on TRACING
	select CONTEXT_SWITCH_TRACER
	default n
	help
	   Trace context swicth, set_scheduler, Interrupt Handler

config MTK_FTRACE_DEFAULT_ENABLE
    bool "enable MTK events by default"
    depends on MTK_SCHED_TRACERS
    default n
    help
        update ring buffer and enable MTK events by default

config MTK_KERNEL_MARKER
	bool "MTK Kernel Marker API"
	depends on TRACING && KALLSYMS
	default n
	help
	  Mark the user-defined points, such as systrace events in
	  user space, to visualize via systrace html files

config MT65XX_TRACER
	bool "MT65XX Tracer"
	select CONTEXT_SWITCH_TRACER
	select GENERIC_TRACER
	default n

menu "MET"

config MTK_MET
	tristate "MET core driver"
	default n
	help
	  The core module of MTK MET profiling tool

config MTK_MET_PLF
	tristate "MET platform-related driver"
	depends on MTK_MET
	default n
	help
	  The platform module of MTK MET profiling tool

endmenu

menuconfig MALI_MIDGARD
	tristate "Mali Midgard series support"
	depends on MTK_MET
	default n
	help
	  Enable this option to build support for a ARM Mali Midgard GPU.

	  To compile this driver as a module, choose M here:
	  this will generate a single module, called mali_kbase.

config MALI_GATOR_SUPPORT
	bool "Streamline Debug support"
	depends on MTK_MET && MALI_MIDGARD
	default n
	help
	  Adds diagnostic support for use with the ARM Streamline Performance Analyzer.
	  You will need the Gator device driver already loaded before loading this driver when enabling
	  Streamline debug support.

config MALI_GPU_TRACEPOINTS
	bool "Enable GPU tracepoints"
	depends on MTK_MET && MALI_MIDGARD && ANDROID
	select GPU_TRACEPOINTS
	help
	  Enables GPU tracepoints using Android trace event definitions.

endmenu

menu "MTPROF tools"

config MTPROF
	bool "Enable MTK profiler/debugger tool"
	default y
	help
	  CONFIG_MTPROF define if mtk profiling tools should be built-in or not. It
	  includes workqueue debugger, signal debugger, cputime, bootprof, and other
	  misc tools. If you are not sure about whether to enable it or not, please
	  set n.

config MTK_MUTATION
	bool "Support some MTK debug/profiling patches"
	default y

config MTPROF_CPUTIME
	bool "thread cputime profiling"
	depends on SCHEDSTATS

endmenu

config MTK_AEE_FEATURE
	tristate "Enable Android Exception Enhancement"
	default n
	select FIQ_GLUE if !TRUSTONIC_TEE_SUPPORT && !ARM_PSCI
	---help---
	  Enable Android Exception Enhancement

config MTK_AEE_AED
	tristate "Enable AEE Kernel Exception Report Daemon"
	default y

config MTK_AEE_IPANIC
	tristate "Enable AEE Kernel Panic Dump"
	default y

config MTK_AEE_POWERKEY_HANG_DETECT
    bool "powerkey monitor"
    default n

config MTK_AEE_MRDUMP
	tristate "Enable AEE RAMDUMP support"
	default y

config ANDROID_VMEM
	tristate "Virutally continuous memory allocator"
	default y

config MTK_RAM_CONSOLE
	bool "mt ram console" 

config MTK_RAM_CONSOLE_USING_SRAM
	bool "Using SRAM as ram console storage"
	depends on MTK_RAM_CONSOLE

config MTK_RAM_CONSOLE_USING_DRAM
	bool "Using DRAM as ram console storage"
	depends on MTK_RAM_CONSOLE

config MTK_RAM_CONSOLE_SIZE
	hex "MTK RAM console  address"
	default 0
	depends on MTK_RAM_CONSOLE

config MTK_RAM_CONSOLE_ADDR
	hex "MTK RAM console buffer size"
	default 0
	depends on MTK_RAM_CONSOLE   

config MTK_RAM_CONSOLE_DRAM_SIZE
	hex "MTK RAM console dram address"
	default 0
	depends on MTK_RAM_CONSOLE

config MTK_RAM_CONSOLE_DRAM_ADDR
	hex "MTK RAM console dram size"
	default 0
	depends on MTK_RAM_CONSOLE   

config PREEMPT_MONITOR
	bool "mt preempt monitor"
	default n

config ISR_MONITOR
	bool "mt ISR monitor"
	default n

config MT_SCHED_MONITOR
	bool "mt scheduler monitor"
	default n

config MT_RT_THROTTLE_MON
	bool "mt rt throttle monitor"
	default n
	help
	  MT_RT_THROTTLE_MON is used to monitor rt throttle. When rt throttle activated
	  print 5 longest execusion time rt tasks. Say Y here to enable rt throttle
	  monitor.
	  If you are not sure about whether to enable it or not, please set n.

config MT_CHRDEV_REG
	bool "mt char driver number table"
	default n

config MT_LOCK_DEBUG
	bool "Record lock table and detect some possible deadlock"
	default n

config MT_DEBUG_MUTEXES
	bool "show mutex owner info"
	depends on DEBUG_MUTEXES 
	default n

config PRINTK_PROCESS_INFO 
	bool "Prefix pid/process_name to each kernel log"
	default n
	
config MT_PRINTK_UART_CONSOLE
	bool "MTK printk UART controller"
	default n

config LOG_TOO_MUCH_WARNING
	bool "printk too much warning"
	default y

config LOG_TOO_MUCH_DETECT_COUNT
	hex "printk too much detect count"
	default 300
	depends on LOG_TOO_MUCH_WARNING

config LOG_TOO_MUCH_DETECT_GAP
	hex "detect log too much delay time"
	default 10
	depends on LOG_TOO_MUCH_WARNING

config MT_ENG_BUILD
	bool "flag for MTK eng/usr build verification"
	default n

config RAMDISK_OFFSET
	hex "Uboot allocate memory offset for RAMDISK"
	default 0xF00000
	help
	Used to check decompressed kernel overwrite ramdisk.
	(DO NOT MODIFY IT YOURSELF.)

config EARLY_LINUX_PORTING
	bool "Support For Linux Early Porting"
	default n
	help

config MTK_MCI
	bool "Support For Memory coherence"
	default n
	help

config MTK_ETM
	bool "Support For Embedded Trace Macrocell"
	default y
	help

config MTK_MEM
	bool "Support platform memory information"
	default y

config MTK_MEMCFG
	bool "Support enhanced memory configurations"
	depends on MTK_MEM
	default n

menu "MT load balance and schedule enhancement"
config MT_LOAD_BALANCE_ENHANCEMENT
	bool "mt load balance enhancement"
	depends on  SMP
	default y

config MT_LOAD_BALANCE_PROFILER
	bool "mt load balance profiler"
	depends on SCHEDSTATS && SMP
	default n

config MT_RT_SCHED
	bool "mt RT scheduling enhancement for big.LITTLE"
	depends on SCHED_HMP
	default n

config MTK_COMPAT
	bool "mt fast mode switching enhancement"
	depends on COMPAT
	default n

config MT_SCHED_INTEROP
	bool "mtk scheduling interopation enhancement"
	default n

config MT_SCHED_TRACE
	bool "mt scheduling trace, output mtk schedule trace into FTRACE"
	default n

config MT_SCHED_DEBUG
	bool "mt scheduling log, also output the scheduling log into Kernel log"
	depends on MT_SCHED_TRACE
	default n

config MT_DEBUG_PREEMPT
	bool "debug preempt, output the preempt enable/disable to FTRACE"
	default n

endmenu

menu "MTK Cluster MultiProcessor Scheduler"
config MTK_SCHED_CMP
        bool "Enable CMP scheduler"
        depends on SMP && SCHED_MC
        default n
        help
          CMP Scheduler Enhancement for MTK SoC.
          Attempts to introspectively select tasks to optimize
          energy and performance.
          say no if not sure.

config MTK_SCHED_CMP_TGS
        bool "Enable thread group scheduling"
        depends on MTK_SCHED_CMP
        default n

config MTK_SCHED_CMP_TGS_WAKEUP
        bool "Enable thread group scheduling"
        depends on MTK_SCHED_CMP_TGS
        default n

config MTK_SCHED_CMP_PACK_SMALL_TASK
        bool "Packing small task"
        depends on MTK_SCHED_CMP && MTK_SCHED_CMP_TGS
        default n

config MTK_SCHED_CMP_LAZY_BALANCE
        bool "Enable CMP lazy balance"
        depends on MTK_SCHED_CMP_PACK_SMALL_TASK
        default n

config MTK_SCHED_CMP_POWER_AWARE_CONTROLLER
	bool "(EXPERIMENTAL) Power-aware Scheduler for MP Controller"
	depends on MTK_SCHED_CMP_PACK_SMALL_TASK && MTK_SCHED_CMP_LAZY_BALANCE
	help
		Power-aware scheduler for MP controller and status interface
endmenu

config MTK_CIRQ
	bool "Support For System CIRQ"
	default n
	help

config MTK_CPU_TOPOLOGY
        bool "MTK cpu topology infrastructure"
        depends on ARM_CPU_TOPOLOGY && OF
        default y
        help
          Say N if you want to build up another wheel

config MTK_HIBERNATION
	bool "Support MTK hibernation"
	depends on HIBERNATION && PM_WAKELOCKS
	default y
	help

config MTK_WQ_DEBUG
	bool "mtk workqueue debug"
	default n


config MTK_STORAGE_PID_LOGGER
	bool "support MTK storage pid logger"
	default y
endmenu

menu "MTK Large Memory mode support"
config MTK_LM_MODE
	bool "MTK Large Memory mode"
	select ARM_LPAE
	select ARCH_PHYS_ADDR_T_64BIT
	select ARCH_DMA_ADDR_T_64BIT
	help
	  Large Memory mode support for supporting more than 4GB DRAM access
endmenu

config MTK_TABLET_HARDWARE
	bool "MTK tablet machine name"
	default n
	help
	  MTM tablet machine name 

config GATOR_DRIVER
	tristate "DS-5 profiling tool kernel driver"
	default n
	depends on PROFILING
	depends on HIGH_RES_TIMERS
	depends on LOCAL_TIMERS || !(ARM && SMP)
	depends on PERF_EVENTS
	depends on HW_PERF_EVENTS || !(ARM || ARM64)
	select TRACING
	help
	  kernel driver of DS-5 profiling tool

config MTK_IPV6_TETHER_NDP_MODE
	bool "MTK_IPV6_TETHER_NDP_MODE"
	help
	  is NDP mode or RADVD mode during IPv6 tethering yes: enable NDP
	  mode during IPv6 tethering no: disable enable NDP mode during IPv6
	  tethering

config MTK_TETHERINGIPV6_SUPPORT
	bool "MTK_TETHERINGIPV6_SUPPORT"
	help
	  support tethering over ipv6

config MTK_LEGACY
	bool "MTK LEGACY driver API support"
	default y
	help
	  This is an option for MTK legacy driver that using old API
	  It will be deprecated after all drivers changed to new structure
```

## kernel-3.10/drivers/misc/mediatek/accelerometer/bmi160_acc/Kconfig
```kconfig
config MTK_BMI160_ACC
        bool "bmi160_acc for MediaTek package"
        default n
```

## kernel-3.10/drivers/misc/mediatek/bringtosee/Kconfig
```kconfig
config CUSTOM_KERNEL_BRINGTOSEE_SENSOR
	bool "CUSTOM_KERNEL_BRINGTOSEE_SENSOR"
	help
	  Kernel space bring to see sensor driver.
```

## kernel-3.10/drivers/misc/mediatek/cirq/Kconfig
```kconfig
config MTK_CIRQ
	bool "Enable MTK System interrupt controller V1"
	default n
	help
	  Enable CIRQ driver V1 support

	  System interrupt controller(SYS_CIRQ) is a low-power interrupt controller
	  which is designed to work outside MCUSYS as second level interrupt controller.
	  With SYS_CIRQ, the MCUSYS can be completely turned off to improve system power consumption without losing interrupts.

config MTK_SYS_CIRQ
	bool "Enable MTK System interrupt controller V2"
	default n
	help
	  Enable CIRQ driver V2 support

	  System interrupt controller(SYS_CIRQ) is a low-power interrupt controller
	  which is designed to work outside MCUSYS as second level interrupt controller.
	  With SYS_CIRQ, the MCUSYS can be completely turned off to improve system power consumption without losing interrupts.
```

## kernel-3.10/drivers/misc/mediatek/consumerir/Kconfig
```kconfig
config MTK_CONSUMERIR_SUPPORT
	bool "MediaTek consumer IR transmitter"
	default n
```

## kernel-3.10/drivers/misc/mediatek/dual_ccci/Kconfig
```kconfig
config MTK_CCCI_EXT # CCCI_DRIVER
	bool "Dual CCCI Driver"
	depends on MTK_CCCI_DEVICES
	default n
	---help---
	  This option enables dual ccci device driver support

config MTK_CCCI_DRIVER # CCCI_DRIVER
	tristate "CCCI Driver"
	depends on MTK_CCCI_DEVICES
	default n
	---help---
	  This option enables ccci device driver support
```

## kernel-3.10/drivers/misc/mediatek/emd_ctl/Kconfig
```kconfig
config CUSTOM_KERNEL_EXTMD
	string "CUSTOM_KERNEL_EXTMD"
	default ""
	help
	  Config external md type. Possible choice can be "mt6261" or "mt6261_x2".
```

## kernel-3.10/drivers/misc/mediatek/gyroscope/Kconfig
```kconfig
config CUSTOM_KERNEL_GYROSCOPE
	bool "CUSTOM_KERNEL_GYROSCOPE"
	help
	  gyroscope driver

source "drivers/misc/mediatek/gyroscope/bmi160_gyro/Kconfig"
```

## kernel-3.10/drivers/misc/mediatek/gyroscope/bmi160_gyro/Kconfig
```kconfig
config MTK_BMI160_GYRO
        bool "BMI160 for MediaTek package"
        default n
        help
        It support different gyroscope sensor.
        If this option is set,
	  	it will support
         BMI160 gyroscope.
```

## kernel-3.10/drivers/misc/mediatek/leds/Kconfig
```kconfig
config MTK_LEDS
	tristate "MediaTek LED Support"
	depends on LEDS_CLASS
	---help---
	  This selects the MediaTek(R) LEDs connected to MediaTek chips.
	  If you want to use MediaTek(R) LEDs support, say Y or M here.
	  If unsure, say N.

config LIGHTNESS_MAPPING_VALUE
	int "LIGHTNESS_MAPPING_VALUE"
	default 255
 	---help---
	  Backlight brightness mapping value, from 0 to 255.
```

## kernel-3.10/drivers/misc/mediatek/mmc-host/Kconfig
```kconfig
# Memory Card
config MTK_MMC
	tristate "MediaTek SD/MMC Card Interface support"
	help
	  This selects the MediaTek(R) Secure digital and Multimedia card 
	  Interface. If you have a machine with a integrated SD/MMC card 
	  reader, say Y or M here. If unsure, say N.

config MTK_EMMC_SUPPORT
	bool "MTK_EMMC_SUPPORT"
	depends on MTK_MMC
	help
	  This enables using embedded Multimedia card (eMMC) as booting 
	  device on MTK platform. Say Y if you turns on MTK_EMMC and want to 
	  use eMMC as booting device. If unsure, say N.


menuconfig MTK_EMMC_CACHE
	tristate "eMMC Cache"
	depends on MTK_EMMC_SUPPORT
	default n
	help
	  This enables eMMC cache scheme designed by MTK. Say Y if you turns 
	  on MTK_EMMC_SUPPORT and want to use MTK eMMC cacheas scheme. 
	  If unsure, say N.

config MTK_EMMC_SUPPORT_OTP
	tristate "MediaTek eMMC Card OTP support"
	depends on MTK_EMMC_SUPPORT
	help
	  This enables MTK One-Time-Programming (OTP) partition support on eMMC
	  device. Say Y if you turns on MTK_EMMC and want to use MTK OTP 
	  partition for storing One-Time-Programming data. If unsure, say N.

config MTK_SDIOAUTOK_SUPPORT
        tristate "MediaTek SDIO Auto-K support (for SDIO 3.0)"
        depends on MTK_MMC
        default n
        help
          This enables MTK auto-calibration (AUTOK) scheme for SDIO timing 
          calibration. This can only be enabled when you turn on MTK_MMC and 
          use MTK proprietary SDIO 3.0 device. Otherwise, say N.

config SDIOAUTOK_SUPPORT
	tristate "MediaTek SDIO UHS auto calibration support"
	depends on MTK_MMC
	default n
	help
	  Alternative name of MTK_SDIOAUTOK_SUPPORT. Some MTK platform use
	  this kerner config name instead of MTK_SDIOAUTOK_SUPPORT.
          This enables MTK auto-calibration (AUTOK) scheme for SDIO timing 
          calibration. This can only be enabled when you turn on MTK_MMC and 
          use MTK proprietary SDIO 3.0 device. Otherwise, say N.
```

## kernel-3.10/drivers/misc/mediatek/nfc/Kconfig
```kconfig
menuconfig MTK_NFC
	tristate "NFC drivers"
	default n
	---help---
	  Say Y here for supporting NFC.

if MTK_NFC

config NFC_MT6605
	tristate "MediaTek NFC driver"
	default n

config NFC_MSR3110
	tristate "MSR3110 NFC driver"
	default n

endif # NFC
```

## kernel-3.10/drivers/misc/mediatek/sched/Kconfig
```kconfig
config MT_SCHED
	bool "Enhance CPU affinity in hotplug"	
 	depends on HOTPLUG
	help
	  The CPU affinity library for Hotplug enhancement is to achieve set CPU 
	  affinity without take care kernel behavior and to avoid affect the original
	  Linux design.

config MTK_SCHED_RQAVG_US
	bool "Enable runqueue staticsic calculation used in user space operation"
	depends on SMP && HIGH_RES_TIMERS
	help
	  TLP estimation for user space CPUfreq governors

config MTK_SCHED_RQAVG_KS
	bool "Enable runqueue staticsic calculation used in kernel space operation"
	depends on SMP
	help
	  TLP estimation for kernel space CPUfreq governors, e.g., hotplug
```

## kernel-3.10/drivers/misc/mediatek/smi/Kconfig
```kconfig
config MTK_SMI_EXT
	bool "SMI Driver"
	default n
	help
	  SMI Driver is used to arbitrate memory bandwidth of multimedia
```
